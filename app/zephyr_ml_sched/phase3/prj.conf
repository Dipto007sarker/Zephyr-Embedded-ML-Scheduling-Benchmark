## CMakeLists.txt
```
cmake_minimum_required(VERSION 3.20.0)
find_package(Zephyr REQUIRED HINTS $ENV{ZEPHYR_BASE})
project(zephyr_ml_sched_phase2)

target_sources(app PRIVATE
    src/main.cpp
    src/assert.cpp
    src/constants.c
    src/main_functions.cpp
    src/model.cpp
    src/output_handler.cpp
)
```

## prj.conf
```kconfig
CONFIG_MAIN_STACK_SIZE=8192
CONFIG_HEAP_MEM_POOL_SIZE=32768

CONFIG_STDOUT_CONSOLE=y
CONFIG_PRINTK=y
CONFIG_CONSOLE=y
CONFIG_SERIAL=y

CONFIG_TIMESLICING=y
CONFIG_TIMESLICE_SIZE=2
CONFIG_TIMING_FUNCTIONS=y

CONFIG_THREAD_NAME=y
CONFIG_INIT_STACKS=y

CONFIG_CPP=y
CONFIG_REQUIRES_FULL_LIBC=y
CONFIG_TENSORFLOW_LITE_MICRO=y

CONFIG_STD_CPP14=y
# CONFIG_STD_CPP11 is not set

CONFIG_SCHED_DEADLINE=y
```

## src/main.cpp
```c
#include <zephyr/kernel.h>
#include <zephyr/sys/printk.h>
#include <zephyr/timing/timing.h>
#include <stdint.h>

extern "C" {
#include "main_functions.h"
}

#define ML_STACK_SIZE 4096
#define RT_STACK_SIZE 2048
#define BG_STACK_SIZE 2048

#define ML_PRIO 4
#define RT_PRIO 4
#define BG_PRIO 6

K_THREAD_STACK_DEFINE(ml_stack, ML_STACK_SIZE);
K_THREAD_STACK_DEFINE(rt_stack, RT_STACK_SIZE);
K_THREAD_STACK_DEFINE(bg_stack, BG_STACK_SIZE);

static struct k_thread ml_thread_data;
static struct k_thread rt_thread_data;
static struct k_thread bg_thread_data;

volatile uint32_t ml_counter = 0;
volatile uint32_t rt_misses = 0;
volatile uint32_t rt_runs = 0;

void ml_task(void *a, void *b, void *c)
{
    ARG_UNUSED(a);
    ARG_UNUSED(b);
    ARG_UNUSED(c);

    setup();

    const int inference_repeats = 20;

    while (1) {
        timing_t start = timing_counter_get();

        for (int i = 0; i < inference_repeats; i++) {
            loop();
        }

        timing_t end = timing_counter_get();
        uint64_t total_cycles = timing_cycles_get(&start, &end);
        uint64_t avg_cycles = total_cycles / inference_repeats;

        ml_counter++;
        printk("[ML] run=%u repeats=%d total_cycles=%llu avg_cycles=%llu\n",
               ml_counter, inference_repeats, total_cycles, avg_cycles);

        k_sleep(K_MSEC(20));
    }
}

void rt_task(void *a, void *b, void *c)
{
    ARG_UNUSED(a);
    ARG_UNUSED(b);
    ARG_UNUSED(c);

    const int period_ms = 200;
    int64_t next_release = k_uptime_get() + period_ms;
    int64_t last_start = 0;

    while (1) {
        int64_t now = k_uptime_get();
        int64_t lateness = now - next_release;
        int64_t gap = (last_start == 0) ? 0 : (now - last_start);

        if (lateness < 0) {
            lateness = 0;
        }

        if (lateness > period_ms) {
            rt_misses++;
        }

        int64_t start = k_uptime_get();
        last_start = start;

        // Small RT workload
        k_busy_wait(5000);

        int64_t finish = k_uptime_get();
        rt_runs++;

        printk("[RT] run=%u exec_ms=%lld lateness_ms=%lld gap_ms=%lld misses=%u\n",
               rt_runs, (finish - start), lateness, gap, rt_misses);

        next_release += period_ms;

        while (next_release <= k_uptime_get()) {
            next_release += period_ms;
        }

        int64_t sleep_ms = next_release - k_uptime_get();
        if (sleep_ms > 0) {
            k_sleep(K_MSEC(sleep_ms));
        }
    }
}

void bg_task(void *a, void *b, void *c)
{
    ARG_UNUSED(a);
    ARG_UNUSED(b);
    ARG_UNUSED(c);

    while (1) {
        for (volatile uint32_t i = 0; i < 200000; i++) {
        }
        k_yield();
    }
}

int main(void)
{
    timing_init();
    timing_start();

    printk("Zephyr ML scheduling benchmark start\n");

    k_tid_t ml_tid = k_thread_create(&ml_thread_data, ml_stack, ML_STACK_SIZE,
                                     ml_task, NULL, NULL, NULL,
                                     ML_PRIO, 0, K_NO_WAIT);

    k_tid_t rt_tid = k_thread_create(&rt_thread_data, rt_stack, RT_STACK_SIZE,
                                     rt_task, NULL, NULL, NULL,
                                     RT_PRIO, 0, K_NO_WAIT);

    k_tid_t bg_tid = k_thread_create(&bg_thread_data, bg_stack, BG_STACK_SIZE,
                                     bg_task, NULL, NULL, NULL,
                                     BG_PRIO, 0, K_NO_WAIT);

    k_thread_name_set(ml_tid, "ml_task");
    k_thread_name_set(rt_tid, "rt_task");
    k_thread_name_set(bg_tid, "bg_task");

    // Uncomment only for equal-priority with deadline experiment
    k_thread_deadline_set(ml_tid, 30);
    k_thread_deadline_set(rt_tid, 10);

    while (1) {
        k_sleep(K_SECONDS(5));
        printk("[SUMMARY] ml_runs=%u rt_runs=%u rt_misses=%u\n",
               ml_counter, rt_runs, rt_misses);
    }

    return 0;
}
```

## src/output_handler.cpp
```c
/*
 * Copyright 2020 The TensorFlow Authors. All Rights Reserved.
 *
 * Licensed under the Apache License, Version 2.0 (the "License");
 * you may not use this file except in compliance with the License.
 * You may obtain a copy of the License at
 *
 *     http://www.apache.org/licenses/LICENSE-2.0
 *
 * Unless required by applicable law or agreed to in writing, software
 * distributed under the License is distributed on an "AS IS" BASIS,
 * WITHOUT WARRANTIES OR CONDITIONS OF ANY KIND, either express or implied.
 * See the License for the specific language governing permissions and
 * limitations under the License.
 */

// #include "output_handler.hpp"

// void HandleOutput(float x_value, float y_value)
// {
// 	/* Log the current X and Y values */
// 	MicroPrintf("x_value: %f, y_value: %f\n",
// 			    static_cast < double > (x_value),
// 			    static_cast < double > (y_value));
// }


#include <zephyr/kernel.h>
#include "output_handler.hpp"

void HandleOutput(float x_value, float y_value)
{
    ARG_UNUSED(x_value);
    ARG_UNUSED(y_value);
}
```

## src/output_handler.hpp
```c
/*
 * Copyright 2020 The TensorFlow Authors. All Rights Reserved.
 *
 * Licensed under the Apache License, Version 2.0 (the "License");
 * you may not use this file except in compliance with the License.
 * You may obtain a copy of the License at
 *
 *     http://www.apache.org/licenses/LICENSE-2.0
 *
 * Unless required by applicable law or agreed to in writing, software
 * distributed under the License is distributed on an "AS IS" BASIS,
 * WITHOUT WARRANTIES OR CONDITIONS OF ANY KIND, either express or implied.
 * See the License for the specific language governing permissions and
 * limitations under the License.
 */

// #ifndef TENSORFLOW_LITE_MICRO_EXAMPLES_HELLO_WORLD_OUTPUT_HANDLER_H_
// #define TENSORFLOW_LITE_MICRO_EXAMPLES_HELLO_WORLD_OUTPUT_HANDLER_H_

// #include <tensorflow/lite/c/common.h>
// #include <tensorflow/lite/micro/micro_log.h>

// /* Called by the main loop to produce some output based on the x and y values */
// void HandleOutput(float x_value, float y_value);

// #endif  /* TENSORFLOW_LITE_MICRO_EXAMPLES_HELLO_WORLD_OUTPUT_HANDLER_H_ */


#ifndef OUTPUT_HANDLER_HPP_
#define OUTPUT_HANDLER_HPP_

void HandleOutput(float x_value, float y_value);

#endif
```
