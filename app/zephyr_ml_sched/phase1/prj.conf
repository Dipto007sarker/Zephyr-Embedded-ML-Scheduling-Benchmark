## CMakeLists.txt
```
cmake_minimum_required(VERSION 3.20.0)
find_package(Zephyr REQUIRED HINTS $ENV{ZEPHYR_BASE})
project(zephyr_ml_sched)

target_sources(app PRIVATE src/main.c)
```

## prj.conf
```kconfig
CONFIG_MAIN_STACK_SIZE=4096
CONFIG_HEAP_MEM_POOL_SIZE=16384

CONFIG_STDOUT_CONSOLE=y
CONFIG_PRINTK=y
CONFIG_CONSOLE=y
CONFIG_SERIAL=y

CONFIG_TIMESLICING=y
CONFIG_TIMESLICE_SIZE=2

CONFIG_SCHED_DEADLINE=y
CONFIG_TIMING_FUNCTIONS=y

CONFIG_THREAD_NAME=y
CONFIG_INIT_STACKS=y
```

## src/main.c
```c
#include <zephyr/kernel.h>
#include <zephyr/sys/printk.h>
#include <zephyr/timing/timing.h>
#include <stdint.h>

#define STACK_SIZE 2048
#define ML_PRIO 4
#define RT_PRIO 4
#define BG_PRIO 6

K_THREAD_STACK_DEFINE(ml_stack, STACK_SIZE);
K_THREAD_STACK_DEFINE(rt_stack, STACK_SIZE);
K_THREAD_STACK_DEFINE(bg_stack, STACK_SIZE);

static struct k_thread ml_thread_data;
static struct k_thread rt_thread_data;
static struct k_thread bg_thread_data;

volatile uint32_t ml_counter = 0;
volatile uint32_t rt_misses = 0;
volatile uint32_t rt_runs = 0;

static inline void fake_ml_inference_work(uint32_t iters)
{
    volatile float x = 0.1f;
    for (uint32_t i = 0; i < iters; i++) {
        x = x * 1.0001f + 0.00001f;
    }
}

void ml_task(void *a, void *b, void *c)
{
    ARG_UNUSED(a); ARG_UNUSED(b); ARG_UNUSED(c);

    while (1) {
        timing_t start = timing_counter_get();

        fake_ml_inference_work(40000);

        timing_t end = timing_counter_get();
        uint64_t cycles = timing_cycles_get(&start, &end);

        ml_counter++;
        printk("[ML] run=%u cycles=%llu\n", ml_counter, cycles);

        k_sleep(K_MSEC(20));
    }
}

void rt_task(void *a, void *b, void *c)
{
    ARG_UNUSED(a); ARG_UNUSED(b); ARG_UNUSED(c);

    const int period_ms = 200;
    int64_t next_release = k_uptime_get() + period_ms;
    int64_t last_start = 0;

    while (1) {
        int64_t now = k_uptime_get();
        int64_t lateness = now - next_release;
        int64_t gap = (last_start == 0) ? 0 : (now - last_start);

        if (lateness < 0) {
            lateness = 0;
        }

        if (lateness > period_ms) {
            rt_misses++;
        }

        int64_t start = k_uptime_get();
        last_start = start;

        k_busy_wait(5000);

        int64_t finish = k_uptime_get();
        rt_runs++;

        printk("[RT] run=%u exec_ms=%lld lateness_ms=%lld gap_ms=%lld misses=%u\n",
            rt_runs, (finish - start), lateness, gap, rt_misses);

        next_release += period_ms;

        while (next_release <= k_uptime_get()) {
            next_release += period_ms;
        }

        int64_t sleep_ms = next_release - k_uptime_get();
        if (sleep_ms > 0) {
            k_sleep(K_MSEC(sleep_ms));
        }
    }
}

void bg_task(void *a, void *b, void *c)
{
    ARG_UNUSED(a); ARG_UNUSED(b); ARG_UNUSED(c);

    while (1) {
        for (volatile uint32_t i = 0; i < 200000; i++) {
        }
        k_yield();
    }
}

int main(void)
{
    timing_init();
    timing_start();

    printk("Zephyr ML scheduling benchmark start\n");

    k_tid_t ml_tid = k_thread_create(&ml_thread_data, ml_stack, STACK_SIZE,
                    ml_task, NULL, NULL, NULL,
                    ML_PRIO, 0, K_NO_WAIT);

    k_tid_t rt_tid = k_thread_create(&rt_thread_data, rt_stack, STACK_SIZE,
                    rt_task, NULL, NULL, NULL,
                    RT_PRIO, 0, K_NO_WAIT);

    k_tid_t bg_tid = k_thread_create(&bg_thread_data, bg_stack, STACK_SIZE,
                    bg_task, NULL, NULL, NULL,
                    BG_PRIO, 0, K_NO_WAIT);

    k_thread_name_set(ml_tid, "ml_task");
    k_thread_name_set(rt_tid, "rt_task");
    k_thread_name_set(bg_tid, "bg_task");

    k_thread_deadline_set(ml_tid, 30);
    k_thread_deadline_set(rt_tid, 10);

    while (1) {
        k_sleep(K_SECONDS(5));
        printk("[SUMMARY] ml_runs=%u rt_runs=%u rt_misses=%u\n",
               ml_counter, rt_runs, rt_misses);
    }

    return 0;
}
```
